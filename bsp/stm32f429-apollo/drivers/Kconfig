## bsp/stm32f429-apollo/drivers/Kconfig
```kconfig
config RT_USING_EXT_SDRAM
    bool "Enable SDRAM on the board"
    default y
 
config RT_USING_UART1
    bool "Enable UART1"
    default y    
    
config RT_USING_UART2
    bool "Enable UART2"
    default y    

config RT_USING_UART3
    bool "Enable UART3"
    default y  
	
config RT_USING_UART6
    bool "Enable UART6"
    default y  
	
config RT_USING_SPI1
    bool "Enable SPI1"
    default y   
	
config RT_USING_SPI2
    bool "Enable SPI2"
    default y 
	
config RT_USING_SPI3
    bool "Enable SPI3"
    default y 
	
config RT_USING_SPI5
    bool "Enable SPI5"
    default y   
	
config RT_USING_SPI6
    bool "Enable SPI6"
    default y   

config RT_RTC_NAME
    string "The name of RTC device"
    default rtc
	
if RT_USING_I2C
	config RT_USING_I2C1
	bool "Enable I2C1"
	default y
	
	config RT_USING_I2C2
	bool "Enable I2C2"
	default y
	
	config RT_USING_I2C3
	bool "Enable I2C3"
	default y
endif

if RT_USING_LWIP
    config CONFIG_PCF8574
        bool
        select RT_USING_I2C
        select RT_USING_I2C_BITOPS
endif
```
